void _display_initialization(){
  // Inicialización de la comunicación con la pantalla
  display.begin();
  // Establecer el contraste del display (0 a 127)
  display.setContrast(50);
  // Limpiar la pantalla
  display.clearDisplay();
  // Establecer el tamaño del texto
  display.setTextSize(1);
  // Establecer el color del texto (1: negro, 0: blanco)
  display.setTextColor(BLACK);
}

const unsigned char frame [] PROGMEM = {
	0xee, 0xf0, 0x00, 0x00, 0x00, 0x00, 0x00, 0x00, 0x00, 0x00, 0x00, 0x2a, 0x30, 0x00, 0x00, 0x00, 
	0x00, 0x00, 0x00, 0x00, 0x00, 0x00, 0xea, 0x30, 0x00, 0x00, 0x00, 0x00, 0x00, 0x00, 0x00, 0x00, 
	0x00, 0x2a, 0x30, 0x00, 0x00, 0x00, 0x00, 0x00, 0x00, 0x00, 0x00, 0x00, 0xee, 0x30, 0x00, 0x00, 
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	0xff, 0xf0, 0x00, 0x3f, 0xff, 0xff, 0xff, 0xff, 0xff, 0xff, 0xff, 0xff, 0xf0
};

void _draw_frame(){
  display.drawBitmap(0, 0,  frame, 84, 23, BLACK);
}

const unsigned char thresholds [] PROGMEM = {
	0x00, 0x00, 0x00, 0x00, 0x00, 0x00, 0x00, 0x00, 0x00, 0x00, 0x00, 0x00, 0x00, 0x00, 0x00, 0x00, 
	0x00, 0x00, 0x00, 0x00, 0x00, 0x00, 0x00, 0x00, 0x00, 0x00, 0x00, 0x00, 0x00, 0x00, 0x00, 0x00, 
	0x00, 0x00, 0x00, 0x00, 0x00, 0x00, 0x00, 0x00, 0x00, 0x00, 0x00, 0x00, 0x00, 0x00, 0x00, 0x00, 
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	0x00, 0x00, 0x00, 0x00, 0x00, 0x00, 0x00, 0x00, 0x00, 0x00, 0x00, 0x00, 0x00
};

void _draw_thresholds(){
  display.drawBitmap(11, 0,  thresholds, 72, 21, BLACK);
}

void _draw_graph(){
  display.fillRect(12,0, 72,21, WHITE); //x,y,width,height,color
  _add_coord(cx,cy);
  _draw_thresholds();
  for (int i = 0; i < MAX_COORDS; i++) {
    for (int j = 0; j < 2; j++) {
      int x = coords[i][0] - cx;
      if (x <= 0) {
        x += 84;
      }
      //display.drawPixel(x, coords[i][1], BLACK);
      display.drawLine(x, coords[i][1], x+1, coords[i][1], BLACK);
    }
  }
  display.display();
  cx++;
}

// Función para agregar una nueva coordenada al array
void _add_coord(int x, int y) {
  static int idx = 0; // Índice del siguiente elemento en el array
  if (idx >= MAX_COORDS) {
    // Si se alcanza el límite del array, reiniciar el índice
    idx = 0;
  }
  coords[idx][0] = x; // Guardar la coordenada x
  coords[idx][1] = y; // Guardar la coordenada y
  idx++; // Aumentar el índice
}

void _print_headers(){
  display.setCursor(0, 32);  // Columna 0, Bank 4
  display.println("Lectura:");
  display.print("U1:    ");
  display.print("U2:");
  display.display();
}

void _print_values(){
  display.fillRect(46, 32, 44,7, WHITE); //x,y,width,height,color
  display.setCursor(46, 32);
  display.print(value);
}